## boards/arm/blueclover_plt_demo_v2/Kconfig.board
```kconfig
# Blue Clover PLT Demo V2 board configuration
#
# Copyright (c) 2021 Blue Clover Devices
#
# SPDX-License-Identifier: Apache-2.0

config  BOARD_BLUECLOVER_PLT_DEMO_V2
	bool "BOARD_BLUECLOVER_PLT_DEMO_V2"
	depends on SOC_NRF52832_QFAA
```

## boards/arm/blueclover_plt_demo_v2/Kconfig.defconfig
```kconfig
# Blue Clover PLT Demo V2 board configuration
#
# Copyright (c) 2021 Blue Clover Devices
#
# SPDX-License-Identifier: Apache-2.0

if BOARD_BLUECLOVER_PLT_DEMO_V2

config BOARD
	default "BOARD_BLUECLOVER_PLT_DEMO_V2"

config BT_CTLR
	default BT

endif # BOARD_BLUECLOVER_PLT_DEMO_V2
```

## boards/arm/ly10demo/Kconfig
```kconfig
# Kconfig - nRF52 LY10DEMO board configuration
#
# Copyright (c) 2019 Blue Clover Devices
#
# SPDX-License-Identifier: Apache-2.0


config BOARD_ENABLE_DCDC
	bool "Enable DCDC mode"
	select SOC_DCDC_NRF52X
	default y
	depends on BOARD_LY10DEMO
```

## boards/arm/ly10demo/Kconfig.board
```kconfig
# Kconfig - nRF52 LY10DEMO configuration
#
# Copyright (c) 2019 Blue Clover Devices
#
# SPDX-License-Identifier: Apache-2.0

config  BOARD_LY10DEMO
	bool "LY10DEMO"
	depends on SOC_NRF52832_QFAA
```

## boards/arm/ly10demo/Kconfig.defconfig
```kconfig
# Kconfig - nRF52 LY10DEMO board configuration
#
# Copyright (c) 2019 Blue Clover Devices
#
# SPDX-License-Identifier: Apache-2.0

if BOARD_LY10DEMO

config BOARD
	default "ly10demo"

config BT_CTLR
	default BT

endif # BOARD_LY10DEMO
```
